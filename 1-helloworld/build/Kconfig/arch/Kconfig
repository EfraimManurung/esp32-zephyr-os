## 1-helloworld/build/Kconfig/arch/Kconfig
```kconfig
# Load arch Kconfig descriptions.
osource "C:/Users/frm19/zephyrproject/zephyr/arch/x86/Kconfig"
osource "C:/Users/frm19/zephyrproject/zephyr/arch/xtensa/Kconfig"
osource "C:/Users/frm19/zephyrproject/zephyr/arch/sparc/Kconfig"
osource "C:/Users/frm19/zephyrproject/zephyr/arch/riscv/Kconfig"
osource "C:/Users/frm19/zephyrproject/zephyr/arch/posix/Kconfig"
osource "C:/Users/frm19/zephyrproject/zephyr/arch/nios2/Kconfig"
osource "C:/Users/frm19/zephyrproject/zephyr/arch/mips/Kconfig"
osource "C:/Users/frm19/zephyrproject/zephyr/arch/arm64/Kconfig"
osource "C:/Users/frm19/zephyrproject/zephyr/arch/arm/Kconfig"
osource "C:/Users/frm19/zephyrproject/zephyr/arch/arc/Kconfig"
```
